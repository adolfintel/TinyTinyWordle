//This is an extremely cut down version of the adafruit SSD1306 and GFX libraries combined into a very small file with the bare minimum functionality required for TTW

#define DISPLAY_ADDRESS 0x3C
#define DISPLAY_CLOCK 1000000UL

#include <Wire.h>
#include <avr/pgmspace.h>

#define SSD1306_BLACK 0
#define SSD1306_WHITE 1

//Adapted from glcdfont (default adafruit gfx library font)
#ifdef REDUCED_CHARSET
static const uint8_t font[] PROGMEM = {
  0x40, 0x40, 0x40, 0x40, 0x40, //0: _
  0x00, 0x00, 0x5F, 0x00, 0x00, //1: !
  0x20, 0x10, 0x08, 0x04, 0x02, //2: /
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  0x44, 0x64, 0x54, 0x4C, 0x44
};
#else
static const uint8_t font[] PROGMEM = {
  0x00, 0x00, 0x00, 0x00, 0x00,
  0x3E, 0x5B, 0x4F, 0x5B, 0x3E,
  0x3E, 0x6B, 0x4F, 0x6B, 0x3E,
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  0x00, 0x00, 0x00, 0x00, 0x00
};
#endif

int16_t cursor_x = 0, cursor_y = 0;
uint8_t textsize = 1;
uint8_t *buffer = NULL;

void clearDisplay(void) {
  memset(buffer, 0, 128 * ((64 + 7) / 8));
}

void ssd1306_sendData(const uint8_t *c, uint16_t n, uint8_t op) {
  uint8_t bytesOut = 0x20;
  while (n--) {
    if (bytesOut & 0x20) {
      Wire.endTransmission();
      Wire.beginTransmission(DISPLAY_ADDRESS);
      Wire.write(op);
      bytesOut = 1;
    }
    Wire.write(*(c++));
    bytesOut++;
  }
  Wire.endTransmission();
}

void displayInit() {
  buffer = malloc(128 * ((64 + 7) / 8));
  clearDisplay();
  Wire.begin();
  Wire.setClock(DISPLAY_CLOCK);
  // Init sequence
  static const uint8_t initSeq[] = {
    0xAE,
    0XD5,
    0x80,
    0xA8,
    0x3F,
    0xD3,
    0x00,
    0x40 | 0x00,
    0x8D,
    0x14,
    0x20,
    0x00,
    0xA0 | 0x01,
    0xC8,
    0xDA,
    0x12,
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    0x2E,
    0xAF
  };
  ssd1306_sendData(initSeq, sizeof(initSeq),0x00);
}

void drawFastHLine(int16_t x, int16_t y, int16_t w,
                   uint8_t color) {

  if (y < 0 || y >= 64) return;
  if (x < 0) {                  // Clip left
    w += x;
    x = 0;
  }
  if ((x + w) >= 128) { // Clip right
    w = (128 - x);
  }
  if (w <= 0) return;
  uint8_t *pBuf = &buffer[(y / 8) * 128 + x], mask = 1 << (y & 7);
  if (color == SSD1306_WHITE) {
    while (w--) {
      *pBuf++ |= mask;
    }
  } else {
    mask = ~mask;
    while (w--) {
      *pBuf++ &= mask;
    };
  }
}

void drawFastVLine(int16_t x, int16_t y,
                   int16_t h, uint8_t color) {
  if (x < 0 || x >= 128) return;
  if (y < 0) {               // Clip top
    h += y;
    y = 0;
  }
  if ((y + h) >= 64) { // Clip bottom
    h = (64 - y);
  }
  if (h <= 0) return;
  
  uint8_t *pBuf = &buffer[(y / 8) * 128 + x];

  // do the first partial byte, if necessary - this requires some masking
  uint8_t mod = (y & 7);
  if (mod) {
    mod = 8 - mod;
    uint8_t mask = ~(0xFF >> mod);
    // adjust the mask if we're not going to reach the end of this byte
    if (h < mod)
      mask &= (0XFF >> (mod - h));
    if (color == SSD1306_WHITE) {
      *pBuf |= mask;
    } else {
      *pBuf &= ~mask;
    }
    pBuf += 128;
  }

  if (h >= mod) { // More to go?
    h -= mod;
    // Write solid bytes while we can - effectively 8 rows at a time
    uint8_t val = color == SSD1306_BLACK ? 0 : 255;
    while(h>=8) {
      *pBuf = val;
      pBuf += 128; // Advance pointer 8 rows
      h -= 8;        // Subtract 8 rows from height
    };
    if (h) { // Do the final partial byte, if necessary
      mod = h & 7;
      // this time we want to mask the low bits of the byte,
      // vs the high bits we did above
      uint8_t mask = ~(0xFF << mod);
      if (color == SSD1306_WHITE) {
        *pBuf |= mask;
      } else {
        *pBuf &= ~mask;
      }
    }
  }
}

void refreshDisplay(void) {
  static const uint8_t dlist1[] = {
    0x22,
    0x00,
    0xFF,
    0x21, 0x00,
    0x7F
  };
  ssd1306_sendData(dlist1, sizeof(dlist1),0x00);
  ssd1306_sendData(buffer, 128 * ((64 + 7) / 8),0x40);
}

void fillRect(int16_t x, int16_t y, int16_t w, int16_t h, uint8_t color) {
  for (int16_t i = x; i < x + w; i++) {
    drawFastVLine(i, y, h, color);
  }
}

void drawRect(int16_t x, int16_t y, int16_t w, int16_t h,
              uint8_t color) {
  drawFastHLine(x, y, w, color);
  drawFastHLine(x, y + h - 1, w, color);
  drawFastVLine(x, y, h, color);
  drawFastVLine(x + w - 1, y, h, color);
}

void displayWriteChar(uint8_t c, bool inverted) {
  uint8_t fg = inverted ? SSD1306_BLACK : SSD1306_WHITE, bg = inverted ? SSD1306_WHITE : SSD1306_BLACK;
  if (c == '\n') {
    cursor_x = 0;
    cursor_y += textsize * 8;
  } else {
#ifdef REDUCED_CHARSET
    bool displayable = true;
#endif
    if ((cursor_x >= 128) || (cursor_y >= 64) || ((cursor_x + 6 * textsize - 1) < 0) || ((cursor_y + 8 * textsize - 1) < 0)) return;
#ifdef REDUCED_CHARSET
    if (c >= 'A' && c <= 'Z') {
      c -= 'A' - 14;
    } else if (c >= 'a' && c <= 'z') {
      c -= 'a' - 40;
    } else if (c >= '0' && c <= '9') {
      c -= '0' - 4;
    } else if (c == '_') {
      c = 0;
    } else if (c == '!') {
      c = 1;
    } else if (c == '/') {
      c = 2;
    } else if (c == '>') {
      c = 3;
    } else displayable = false;
    if (displayable) {
#endif
      for (uint8_t i = 0; i < 5; i++) {
        uint8_t line = pgm_read_byte(&font[c * 5 + i]);
        for (uint8_t j = 0; j < 8; j++, line >>= 1) {
          fillRect(cursor_x + i * textsize, cursor_y + j * textsize, textsize, textsize, line & 1 ? fg : bg);
        }
      }
#ifdef REDUCED_CHARSET
    }
#endif
    cursor_x += textsize * 6;
  }
}

void setTextSize(uint8_t s) {
  textsize = s < 1 ? 1 : s;
}

void setCursor(int16_t x, int16_t y) {
  cursor_x = x;
  cursor_y = y;
}

void displayWriteString(char* s, bool inverted = false) {
  while (*s != '\0') {
    displayWriteChar(*(s++), inverted);
  }
}
